#define LED_PIN 2     // пин ленты
#define TM1637_PIN_DIO 3 // DIO пин сегментного дисплея
#define TM1637_PIN_CLK 4 // CLK пин сегментного дисплея
#define BIP_PIN 5 // пин пищалки
#define LED_NUM 8   // кол-во светодиодов
#define LED_BR 40     // яркость ленты
#define MIN_SPEED 1000   // минимальная скорость
#define MAX_SPEED 125  // максимальная скорость


//подключаем библиотеки
#include <GyverOLED.h> // подключаем библиотеку oled дисплея
#include <microLED.h> // подключаем библиотеку светодиодной ленты
#include <VolAnalyzer.h> // подключаем библиотеку микрофона
#include <Clap.h> // подключаем библиотеку распознования хлопков
#include <GyverTM1637.h> // подключаем библиотеку сегментного дисплея
// #include <ServoSmooth.h> // подключаем библиотеку сервоприводов

//инициализируем устройства
// ServoSmooth servo1; // инициализация сервопривода
GyverOLED<SSD1306_128x64, OLED_NO_BUFFER> oled; //инициализация oled дисплея
GyverTM1637 disp(TM1637_PIN_CLK, TM1637_PIN_DIO); // инициализация сегментного дисплея
VolAnalyzer vol(A0); // инициализация микрофона
Clap clap; // инициализация функции распознования хлопков
microLED <LED_NUM, LED_PIN, -1, LED_WS2811, ORDER_RGB> strip; //инициализация светодиодной ленты

// переменные
int massiv[8]= {1, 1, 1, 1, 1, 1, 1, 1}; //опорный массив для расчёта игры
uint32_t tmr1; //таймер для отрисовки позиции светодиода
uint32_t tmr2; //таймер проверки победы
uint32_t tmr3; //таймер для сегметного дисплея
int pos = random(8); // изначальная позиция светодиода
int spd = MIN_SPEED; //изначальная скорость изменения позиции светодиода
int sum; //вспомогательная переменная для рассчета суммы всех элементов массива massiv для расчета скорости изменения позиции светодиода
int a = 1; //вспомогательная переменная для изменения позиции светодиода
int b = 30; //переменная таймера
const uint8_t zaic[] PROGMEM = { //рисунок обычный заяц
 0x00, 0x00, 0x00, 0x00, 0x00, 0x00, 0x00, 0x00, 0x00, 0x00, 0x00, 0x00,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 0x00, 
  0x00, 0x00, 0x00, 0x00, 0x00, 0x00, 0x00, 0x00, 0x00, 0x00, 0x00, 0x00,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 0x00, 
  0x00, 0x00, 0x00, 0x00, 0x00, 0x00, 0x00, 0x00, 0x00, 0x00, 0x00, 0x00,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 0x00, 
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  0x00, 0x00, 0x00, 0x00, 0x00, 0x00, 0x00, 0x00, 0x00, 0x00, 0x00, 0x00,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 0x00, 
};
const uint8_t zloy[] PROGMEM = { //рисунок злой заяц
 0x00, 0x00, 0x00, 0x00, 0x00, 0x00, 0x00, 0x00, 0x00, 0x00, 0x00, 0x00,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 0x00, 
  0x00, 0x00, 0x00, 0x00, 0x00, 0x00, 0x00, 0x00, 0x00, 0x00, 0x00, 0x00,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 0x00, 
  0x00, 0x00, 0x00, 0x00, 0x00, 0x00, 0x00, 0x00, 0x00, 0x00, 0x00, 0x00,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 0x00, 
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  0x00, 0x00, 0x00, 0x00, 0x00, 0x00, 0x00, 0x00, 0x00, 0x00, 0x00, 0x00,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 0x00, 
};
const uint8_t usi[] PROGMEM = { //рисунок заяц с лежачими ушами
  0x00, 0x00, 0x00, 0x00, 0x00, 0x00, 0x00, 0x00, 0x00, 0x00, 0x00, 0x00,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 0x00, 
  0x00, 0x00, 0x00, 0x00, 0x00, 0x00, 0x00, 0x00, 0x00, 0x00, 0x00, 0x00,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 0x00, 
  0x00, 0x00, 0x00, 0x00, 0x00, 0x00, 0x00, 0x00, 0x00, 0x00, 0x00, 0x00,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 0x00, 
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  0x00, 0x00, 0x00, 0x00, 0x00, 0x00, 0x00, 0x00, 0x00, 0x00, 0x00, 0x00,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 0x00, 
};



void setup() {
  oled.init(); //включаем oled дисплей
  gameStart(); //начинаем игру, рисуем зайца
  disp.clear(); //вклюаем сегментный дисплей      
  disp.brightness(7); //установить яркость сегментного дисплея
  pinMode(BIP_PIN, OUTPUT); //включаем пищалку
  strip.setBrightness(LED_BR); //установить яркость светодиодной ленты
  strip.clear(); //очищаем ленту от старых значений
  fillZone(); //меняем значение массива светодиодной ленты согласно массиву massiv
  strip.show(); //окрашиваем светодиодную ленту 
  servo1.attach(5, 600, 2400); //включаем сервопривод
  }

 
void loop() {
 poolButtons(); //опрашиваем микрофон на наличие хлопков/щелчков
 gameRoutine(); //играем игру
 servoCheck(); 
 }
  
  
void gameRoutine(){
    if (millis() - tmr1 >= spd) {
    tmr1 = millis();
    pos += a;
    if (pos >= LED_NUM){
      pos = 0;
    } else if (pos < 0){
      pos = 7;
    }
     tone(BIP, 40, 100);         
  }    
    strip.clear();
    fillZone();
    strip.leds[pos] = mRGB(255,255,0);          
    strip.show();
          
    if (millis() - tmr2 >= 10) {
      tmr2 = millis();
      if (massiv[0] <= 0 && massiv[1] <= 0 && massiv[2] <= 0 && massiv[3] <= 0 && massiv[4] <= 0 && massiv[5] <= 0 && massiv[6] <= 0 && massiv[7] <= 0){
        gameWin();
      }
  }
  if (millis() - tmr3 >= 1000) {
    if (b > 0){
    tmr3 = millis();
    disp.displayInt(b);
    b=b-1;
    } else{
      if (massiv[0] <= 0 && massiv[1] <= 0 && massiv[2] <= 0 && massiv[3] <= 0 && massiv[4] <= 0 && massiv[5] <= 0 && massiv[6] <= 0 && massiv[7] <= 0){
        }
      else {
      disp.clear();
      gameOver();
      }
  }
}
}
   
void poolButtons() { 
  vol.tick();
  clap.tick(vol.getRawMax());
  if (clap.isClap()) {
    massiv[pos]=massiv[pos]*-1;
    strip.clear();
    fillZone();
    strip.show();
    sum = 0;
    for (int i = 0; i < LED_NUM; i++){
      sum += massiv[i];
      }
      spd = map(sum, -8, 8, MAX_SPEED, MIN_SPEED);
    a=a*-1;
    }
}

void fillZone(){
  for (int i = 0; i < LED_NUM; i++) {
    switch (massiv[i]){
      case 1:{
      strip.leds[i] = mRGB(255,0,0);
      break;
    }
      case -1:{
      strip.leds[i] = mRGB(0,255,0);
      break;
      }
    case 0:{
      strip.leds[i] = mRGB(0,0,0);
      }
  }
  }
  }
void gameWin() {
      strip.fill(mRGB(0,255,0));
      tone(BIP, 40, 300);
      delay (500);
      strip.fill(mRGB(0,0,0));
      delay (500);
      }

 void gameOver() {
      strip.fill(mRGB(255,0,0));
      tone(BIP, 40, 300);
      oled.drawBitmap(-10, 0, zloy, 128, 64, BITMAP_NORMAL, BUF_ADD);
      delay (500);
      strip.fill(mRGB(0,0,0));
      oled.drawBitmap(10, 0, zloy, 128, 64, BITMAP_NORMAL, BUF_ADD);
      delay (500);
      }

void gameStart() {
  oled.clear();
  oled.drawBitmap(0, -56, usi, 128, 64, BITMAP_NORMAL, BUF_ADD);
  delay(100);
  oled.drawBitmap(0, -48, usi, 128, 64, BITMAP_NORMAL, BUF_ADD);
  delay(100);
  oled.drawBitmap(0, -40, usi, 128, 64, BITMAP_NORMAL, BUF_ADD);
  delay(100);
  oled.drawBitmap(0, -32, usi, 128, 64, BITMAP_NORMAL, BUF_ADD);
  delay(100);
  oled.drawBitmap(0, -24, usi, 128, 64, BITMAP_NORMAL, BUF_ADD);
  delay(100);
  oled.drawBitmap(0, -16, usi, 128, 64, BITMAP_NORMAL, BUF_ADD);
  delay(100);
  oled.drawBitmap(0, -8, usi, 128, 64, BITMAP_NORMAL, BUF_ADD);
  delay(100);
  oled.drawBitmap(0, 0, zaic, 128, 64, BITMAP_NORMAL, BUF_ADD);
  delay(500);
  oled.drawBitmap(0, 0, zloy, 128, 64, BITMAP_NORMAL, BUF_ADD);
  delay(500);
  oled.drawBitmap(0, 0, zaic, 128, 64, BITMAP_NORMAL, BUF_ADD);
  delay(500);
  oled.drawBitmap(0, 0, zloy, 128, 64, BITMAP_NORMAL, BUF_ADD);
  delay(500);
  oled.drawBitmap(0, 0, zaic, 128, 64, BITMAP_NORMAL, BUF_ADD);
}

// void servoCheck() {
//   if (massiv[0] <=0){
//     servo1.setTargetDeg(0);
//   } else {
//     servo1.setTargetDeg(180);
//   }
//   servo1.tick();
// }
